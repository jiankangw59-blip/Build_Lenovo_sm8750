## efficiency/frame_policy/Kconfig
```kconfig
config FRAME_POLICY
	bool "Event-driven Android frame and Scene frequency policies"
	depends on ARM64 && UPROBES && CPU_FREQ && PM && TRACING
	depends on PERF_EVENTS && SYNC_FILE && INPUT
	default n
	help
	  Provides mutually exclusive Scene and game frame frequency requests.
	  Runtime configuration and an existing Scene event owner are required.
	  CPU and GPU policies can be enabled independently.

config FRAME_POLICY_KUNIT_TEST
	bool "Frame policy context and fence lifecycle KUnit tests"
	depends on FRAME_POLICY && KUNIT=y
	default n
```

## efficiency/xcy-reclaim/Kconfig
```kconfig
config XCY_RECLAIM
	bool "Event-driven XiaoCaiYe memory pressure controller"
	depends on MMU && PSI && ARM64 && KERNEL_MODE_NEON && SECURITY_SELINUX
	help
	  Allow the Ace 6 controller to consume Framework PSS and application
	  protection observations from the existing Android system process.
	  It uses kernel PSI to request new observations only under pressure.
	  Without a publisher and fresh protection data it cannot send signals.
```
